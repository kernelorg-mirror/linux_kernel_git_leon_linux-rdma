## drivers/dpll/Kconfig
```kconfig
# SPDX-License-Identifier: GPL-2.0-only
#
# Generic DPLL drivers configuration
#

menuconfig DPLL
	bool "DPLL drivers configuration"
	help
	  DPLL driver configuration subsystem which provides general interface
	  to configure devices that use any kind of Digital PLL and could use
	  different sources of input signal to synchronize to, as well as
	  different types of outputs.

if DPLL

config MLX5_DPLL
	tristate "Mellanox 5th generation network adapters (ConnectX series) DPLL support"
	depends on MLX5_CORE
	help
	  DPLL support in Mellanox Technologies ConnectX NICs.

	  This option enables support for Digital Phase-Locked Loop (DPLL) functionality
	  in Mellanox 5th generation network adapters (ConnectX series). DPLL allows
	  precise time synchronization between network nodes, which is essential for
	  time-sensitive applications such as financial trading or telecom systems.

	  Enabling this feature provides access to advanced time synchronization hardware
	  capabilities, useful for configurations involving PTP (Precision Time Protocol).

	  If you don't know what to do here, say N.
endif
```

## drivers/infiniband/hw/mlx5/Kconfig
```kconfig
# SPDX-License-Identifier: GPL-2.0-only
config MLX5_INFINIBAND
	tristate "Mellanox 5th generation network adapters (ConnectX series) support"
	depends on NETDEVICES && ETHERNET && PCI && MLX5_CORE
	help
	  This driver provides low-level InfiniBand support for
	  Mellanox Connect-IB PCI Express host channel adapters (HCAs).
	  This is required to use InfiniBand protocols such as
	  IP-over-IB or SRP with these devices.

config MLX5_IPOIB
	bool "Mellanox 5th generation network adapters (connectX series) IPoIB offloads support"
	depends on MLX5_CORE_EN && MLX5_INFINIBAND
	help
	  MLX5 IPoIB offloads & acceleration support.
```

## drivers/infiniband/sw/rxe/Kconfig
```kconfig
# SPDX-License-Identifier: GPL-2.0-only
config RDMA_RXE
	tristate "Software RDMA over Ethernet (RoCE) driver"
	depends on INET && PCI && INFINIBAND && 64BIT
	depends on INFINIBAND_VIRT_DMA
	depends on RUST
	select NET_UDP_TUNNEL
	select CRC32
	help
	This driver implements the InfiniBand RDMA transport over
	the Linux network stack. It enables a system with a
	standard Ethernet adapter to interoperate with a RoCE
	adapter or with another system running the RXE driver.
	Documentation on InfiniBand and RoCE can be downloaded at
	www.infinibandta.org and www.openfabrics.org. (See also
	siw which is a similar software driver for iWARP.)

	The driver is split into two layers, one interfaces with the
	Linux RDMA stack and implements a kernel or user space
	verbs API. The user space verbs API requires a support
	library named librxe which is loaded by the generic user
	space verbs API, libibverbs. The other layer interfaces
	with the Linux network stack at layer 3.

	RXE requires Rust support, including a supported architecture and
	toolchain. Configurations incompatible with RUST, such as RANDSTRUCT,
	cannot enable this driver. There is no C implementation fallback.

	To configure and work with soft-RoCE driver please use the
	following wiki page under "configure Soft-RoCE (RXE)" section:

	https://github.com/linux-rdma/rdma-core/blob/master/Documentation/rxe.md

config RDMA_RXE_KUNIT_TEST
	bool "KUnit tests for RXE Rust policy" if !KUNIT_ALL_TESTS
	depends on RDMA_RXE && KUNIT=y
	default KUNIT_ALL_TESTS
	help
	  Test RXE management datagram encoding, queue resizing, receive queue
	  limits and task scheduling without requiring an RDMA device.
	  They run at boot when RXE is built in, or on loading rdma_rxe when
	  the driver is built as a module.
```

## drivers/lib/Kconfig
```kconfig
# SPDX-License-Identifier: GPL-2.0-only
menuconfig DRIVERS_LIB
	bool "Core driver logic for multi-subsystem drivers"
	help
	  Core drivers for low level functionality of multi-subsystem drivers
	  See Documentation/driver-api/lib.rst for more details.

	  If you don't know what to do here, say N.

if DRIVERS_LIB
source "drivers/lib/nvidia/Kconfig"
endif #DRIVERS_LIB
```

## drivers/lib/nvidia/Kconfig
```kconfig
# SPDX-License-Identifier: GPL-2.0-only

config MLX5_CORE
	tristate "Mellanox 5th generation network adapters (ConnectX series) core driver"
	depends on PCI
	select AUXILIARY_BUS
	select NET_DEVLINK
	depends on VXLAN || !VXLAN
	depends on MLXFW || !MLXFW
	depends on PTP_1588_CLOCK_OPTIONAL
	depends on PCI_HYPERV_INTERFACE || !PCI_HYPERV_INTERFACE
	depends on HWMON || !HWMON
	help
	  Core driver for low level functionality of the ConnectX-4 and
	  Connect-IB cards by Mellanox Technologies.
```

## rust/kernel/Kconfig.test
```kconfig
# SPDX-License-Identifier: GPL-2.0-only
menuconfig RUST_KUNIT_TESTS
	bool "Rust KUnit tests"
	depends on KUNIT && RUST
	default KUNIT_ALL_TESTS
	help
	  This menu collects all options for Rust KUnit tests.
	  See Documentation/rust/testing.rst for how to protect
	  unit tests with these options.

	  Say Y here to enable Rust KUnit tests.

	  If unsure, say N.

if RUST_KUNIT_TESTS
config RUST_ALLOCATOR_KUNIT_TEST
	bool "KUnit tests for Rust allocator API" if !KUNIT_ALL_TESTS
	default KUNIT_ALL_TESTS
	help
	  This option enables KUnit tests for the Rust allocator API.
	  These are only for development and testing, not for regular
	  kernel use cases.

	  If unsure, say N.

config RUST_KVEC_KUNIT_TEST
	bool "KUnit tests for Rust KVec API" if !KUNIT_ALL_TESTS
	default KUNIT_ALL_TESTS
	help
	  This option enables KUnit tests for the Rust KVec API.
	  These are only for development and testing, not for
	  regular kernel use cases.

	  If unsure, say N.

config RUST_BITMAP_KUNIT_TEST
	bool "KUnit tests for Rust bitmap API" if !KUNIT_ALL_TESTS
	default KUNIT_ALL_TESTS
	help
	  This option enables KUnit tests for the Rust bitmap API.
	  These are only for development and testing, not for regular
	  kernel use cases.

	  If unsure, say N.

config RUST_KUNIT_SELFTEST
	bool "KUnit selftests for Rust" if !KUNIT_ALL_TESTS
	default KUNIT_ALL_TESTS
	help
	  This option enables KUnit selftests. These are only
	  for development and testing, not for regular kernel
	  use cases.

	  If unsure, say N.

config RUST_STR_KUNIT_TEST
	bool "KUnit tests for Rust strings API" if !KUNIT_ALL_TESTS
	default KUNIT_ALL_TESTS
	help
	  This option enables KUnit tests for the Rust strings API.
	  These are only for development and testing, not for regular
	  kernel use cases.

	  If unsure, say N.

config RUST_ATOMICS_KUNIT_TEST
	bool "KUnit tests for Rust atomics API" if !KUNIT_ALL_TESTS
	default KUNIT_ALL_TESTS
	help
	  This option enables KUnit tests for the Rust atomics API.
	  These are only for development and testing, not for regular
	  kernel use cases.

	  If unsure, say N.

config RUST_BITFIELD_KUNIT_TEST
	bool "KUnit tests for the Rust `bitfield!` macro" if !KUNIT_ALL_TESTS
	default KUNIT_ALL_TESTS
	help
	  This option enables KUnit tests for the Rust `bitfield!` macro.
	  These are only for development and testing, not for regular
	  kernel use cases.

	  If unsure, say N.

config RUST_SHARED_VMALLOC_KUNIT_TEST
	bool "KUnit tests for Rust shared vmalloc memory" if !KUNIT_ALL_TESTS
	depends on MMU
	default KUNIT_ALL_TESTS
	help
	  This option enables range, alignment and shared-access tests for
	  memory mapped into userspace. These are only for development and
	  testing, not for regular kernel use cases.

	  If unsure, say N.

config RUST_NET_NAMESPACE_KUNIT_TEST
	bool "KUnit tests for Rust namespace ownership" if !KUNIT_ALL_TESTS
	depends on NET
	default KUNIT_ALL_TESTS
	help
	  This option tests typed per-namespace registration, failure rollback,
	  reader drainage and stale-key rejection after registration is replaced.
	  These tests are intended for development, not regular kernel use.

	  If unsure, say N.

config RUST_UDP_TUNNEL_KUNIT_TEST
	bool "KUnit tests for Rust UDP tunnel ownership" if !KUNIT_ALL_TESTS
	depends on NET_UDP_TUNNEL=y
	default KUNIT_ALL_TESTS
	help
	  This option tests shared tunnel users, closing ports with outstanding
	  protocol references, and replacement of tunnel registrations while
	  old leases remain. These tests are intended for development.

	  If unsure, say N.

config RUST_UDP_PACKET_KUNIT_TEST
	bool "KUnit tests for Rust UDP packet ownership" if !KUNIT_ALL_TESTS
	depends on INET
	default KUNIT_ALL_TESTS
	help
	  This option tests UDP encapsulation header bounds and the payload
	  allocation's initialized bytes and aligned network-header space.
	  These tests are intended for development.

	  If unsure, say N.

config RUST_SKBUFF_KUNIT_TEST
	bool "KUnit tests for Rust socket buffers" if !KUNIT_ALL_TESTS
	depends on NET
	default KUNIT_ALL_TESTS
	help
	  This option enables copy and ownership tests for socket buffers.
	  These are only for development and testing, not for regular
	  kernel use cases.

	  If unsure, say N.

endif
config RUST_RDMA_ODP_KUNIT_TEST
	bool "KUnit tests for Rust on-demand RDMA memory" if !KUNIT_ALL_TESTS
	depends on KUNIT=y && RUST && INFINIBAND=y
	depends on INFINIBAND_ON_DEMAND_PAGING && INFINIBAND_VIRT_DMA
	default KUNIT_ALL_TESTS
	help
	  Test bounded copies and atomic accesses through guarded ODP PFNs.
	  Cover system-page indexing in large-page registrations, unaligned
	  user ranges and read-only access. The fixtures use owned pages;
	  they do not exercise faults or require a userspace memory map.
```
